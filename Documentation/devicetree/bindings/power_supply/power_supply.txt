## drivers/staging/tegra/media/Kconfig
```kconfig
source "drivers/staging/tegra/media/avp/Kconfig"
source "drivers/staging/tegra/media/mediaserver/Kconfig"
source "drivers/staging/tegra/media/camera/Kconfig"
```

## drivers/staging/tegra/media/camera/Kconfig
```kconfig
config TEGRA_CAMERA
        bool "Enable support for tegra camera/isp hardware"
        depends on ARCH_TEGRA
        default y
        help
          Enables support for the Tegra camera interface

          If unsure, say Y

config VIDEO_OV5650
        tristate "OV5650 camera sensor support"
        depends on I2C && ARCH_TEGRA && TEGRA_CAMERA
        ---help---
          This is a driver for the Omnivision OV5650 5MP camera sensor
          for use with the tegra isp.

config VIDEO_YUV
        tristate "SOC2031 camera sensor support"
        depends on I2C && ARCH_TEGRA && TEGRA_CAMERA
        default n
        ---help---
          This is a driver for MT9D115 2M YUV camera sensor

config VIDEO_YUV5
        tristate "SOC5140 camera sensor support"
        depends on I2C && ARCH_TEGRA && TEGRA_CAMERA
        default n
        ---help---
          This is a driver for MT9P111 5M YUV camera sensor

config VIDEO_LTC3216
        tristate "LTC3216 flash support"
        depends on I2C && ARCH_TEGRA
        default n
        ---help---
          This is a driver for AD5820 focuser

config VIDEO_AD5820
        tristate "AD5820 focuser support"
        depends on I2C && ARCH_TEGRA && TEGRA_CAMERA
        ---help---
          This is a driver for the AD5820 focuser
          for use with the tegra isp.
```
